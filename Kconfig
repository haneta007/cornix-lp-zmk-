## Kconfig
```kconfig
config ZMK_NAPE_BRIDGE
    bool "Nape BLE HID to USB mouse bridge"
    depends on BT && BT_CENTRAL && BT_GATT_CLIENT && ZMK_POINTING && ZMK_SPLIT_ROLE_CENTRAL
    default y if SHIELD_CORNIX_NAPE_BRIDGE

config ZMK_NAPE_CURSOR_INERTIA
    bool "Nape cursor inertia"
    depends on ZMK_NAPE_BRIDGE
    default y
    help
      Add decaying cursor movement after a flick. Disable for comparison
      without changing cursor acceleration or the FN_SCROLL path.

config ZMK_NAPE_CURSOR_ACCELERATION
    bool "Nape cursor acceleration"
    depends on ZMK_NAPE_BRIDGE
    default y
    help
      Disable to pass raw cursor XY through without the firmware gain.
      The FN_SCROLL filter and scaler remain unchanged.

config ZMK_NAPE_TIMING_DIAGNOSTICS
    bool "Aggregate Nape input timing logs"
    depends on ZMK_NAPE_BRIDGE
    default n
    select LOG
    help
      Log negotiated BLE parameters and aggregate input timing once per
      second while reports are processed. Adds no thread or workqueue.

config ZMK_NAPE_ZERO_LATENCY
    bool "Use zero peripheral latency for Nape parameter requests"
    depends on ZMK_NAPE_BRIDGE
    default n
    help
      Experimental comparison: accept Nape peer parameter requests with
      latency zero, leaving their interval and supervision timeout unchanged.
      Does not modify Cornix links. May increase Nape battery consumption.

config ZMK_NAPE_NAME
    string "BLE HID device name to pair"
    default "Nape Pro"
    depends on ZMK_NAPE_BRIDGE

config ZMK_NAPE_DEBUG
    bool "Verbose Nape HID and BLE logging"
    default n
    depends on ZMK_NAPE_BRIDGE
    select LOG
    select USE_SEGGER_RTT
    select LOG_BACKEND_RTT

config ZMK_NAPE_BOND_DIAGNOSTICS
    bool "Log stored Bluetooth bonds for Nape diagnostics"
    default n
    depends on ZMK_NAPE_BRIDGE

config ZMK_NAPE_BOND_CLEANUP_ONLY
    bool "Remove only the previously identified Nape bonds and stop"
    default n
    depends on ZMK_NAPE_BRIDGE
```

## boards/shields/cornix_nape_bridge/Kconfig.shield
```kconfig
config SHIELD_CORNIX_NAPE_BRIDGE
    def_bool $(shields_list_contains,cornix_nape_bridge)
```

## config-baseline/west.yml
```yaml
manifest:
  remotes:
    - name: zmkfirmware
      url-base: https://github.com/zmkfirmware
    - name: englmaxi
      url-base: https://github.com/englmaxi
    - name: urob
      url-base: https://github.com/urob
    - name: haneta007
      url-base: https://github.com/haneta007
  projects:
    # Resolved from the dev manifest used by Actions run 35829390895.
    - name: zmk
      remote: zmkfirmware
      revision: 9ebbeff0a8b69a42f14aec022cdf16c7a107b9e0
      clone-depth: 1
      import:
        file: app/west.yml
    - name: zmk-helpers
      remote: urob
      revision: 7bcba18fc8df27303eb92a435d33ea870cc51f98
      clone-depth: 1
    - name: zmk-dongle-display
      remote: englmaxi
      revision: 2bb333f87136d33e94a49d86236ed9ec254a8060
      clone-depth: 1
    - name: prospector-zmk-module
      remote: haneta007
      repo-path: prospector---Zmk-module
      revision: ed98221f3b52b7066dbb10ba3af8a29150b93a5a
      path: modules/prospector-zmk-module
  self:
    path: config-baseline
```

## config/west.yml
```yaml
manifest:
  remotes:
    - name: zmkfirmware
      url-base: https://github.com/zmkfirmware
    - name: hitsmaxft
      url-base: https://github.com/hitsmaxft
    - name: englmaxi
      url-base: https://github.com/englmaxi
    - name: urob
      url-base: https://github.com/urob
    - name: janpfischer
      url-base: https://github.com/janpfischer
    - name: haneta007
      url-base: https://github.com/haneta007
  projects:
    - name: zmk
      remote: haneta007
      revision: edafb3b058445329d4cbc226621eb1d37529480c
      clone-depth: 1
      import:
        file: app/west.yml
    - name: zmk-helpers
      remote: urob
      revision: 7bcba18fc8df27303eb92a435d33ea870cc51f98
      clone-depth: 1
    #- name: zmk-rgbled-widget
    #  remote: hitsmaxft
    #  revision: main
    #  clone-depth: 1
    - name: zmk-dongle-display
      remote: englmaxi
      revision: 2bb333f87136d33e94a49d86236ed9ec254a8060
      clone-depth: 1
    - name: prospector-zmk-module
      remote: haneta007
      repo-path: prospector---Zmk-module
      revision: 28438c476e2e17d648ce25a14d85525997cc48e3
      path: modules/prospector-zmk-module
    #- name: zmk-dongle-screen
    #  remote: janpfischer
    #  revision: main
    #  clone-depth: 1
  self:
    path: config
```

## dts/bindings/input/nape,virtual-pointer.yaml
```yaml
description: Nape bridge virtual pointing input device
compatible: "nape,virtual-pointer"
include: base.yaml
```

## dts/bindings/input_processors/nape,input-processor-inertia.yaml
```yaml
# SPDX-License-Identifier: MIT

description: Tracks Nape cursor motion and gates synthetic cursor inertia events

compatible: "nape,input-processor-inertia"

include: ip_zero_param.yaml
```
